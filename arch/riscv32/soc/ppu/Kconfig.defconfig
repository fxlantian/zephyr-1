## arch/riscv32/soc/ppu/Kconfig.defconfig
```kconfig
if SOC_RISCV32_PPU

config SOC
	string
	default "ppu"

config SYS_CLOCK_HW_CYCLES_PER_SEC
	int
	default 50000000

config RISCV_SOC_CONTEXT_SAVE
	bool
	default y

config RISCV_SOC_INTERRUPT_INIT
	bool
	default y

config RISCV_HAS_CPU_IDLE
	bool
	default y

config INCLUDE_RESET_VECTOR
	bool
	default y

config NUM_IRQS
	int
	default 32

config ITCM_BASE_ADDRESS
	hex
	default	0x50000000
#	default	0x26000000

config ITCM_SIZE
	hex
	default 0x800000

config DTCM_BASE_ADDRESS
	hex
	default 0x51000000
#	default 0x26800000

config DTCM_SIZE
	hex
	default 0x800000

if UART_NS16550

config UART_NS16550_PCI
	bool
	default n

config UART_NS16750
	bool
	default y

config UART_NS16550_PORT_0
	bool
	default y

config UART_NS16550_PORT_1
	bool
	default n

if UART_NS16550_PORT_0

config UART_NS16550_PORT_0_NAME
	string
	default "UART_0"

config UART_NS16550_PORT_0_IRQ_PRI
	int
	default 0

config UART_NS16550_PORT_0_BAUD_RATE
	int
	default 115200

config UART_NS16550_PORT_0_OPTIONS
	int
	default 0

endif # UART_NS16550_PORT_0

if UART_NS16550_PORT_1

config UART_NS16550_PORT_1_NAME
	string
	default "UART_1"

config UART_NS16550_PORT_1_IRQ_PRI
	int
	default 0

config UART_NS16550_PORT_1_BAUD_RATE
	int
	default 115200

config UART_NS16550_PORT_1_OPTIONS
	int
	default 0

endif # UART_NS16550_PORT_1

endif # UART_NS16550

endif # SOC_RISCV32_PPU
```

## arch/riscv32/soc/ppu/Kconfig.soc
```kconfig
config SOC_RISCV32_PPU
	bool "PPU SOC by WuSystem Group @ ICT, CAS"
	select ATOMIC_OPERATIONS_C
```

## boards/riscv32/artix7_ppu/Kconfig.board
```kconfig
config BOARD_ARTIX7_PPU
	bool "Xilinx Artix7 Board PPU target"
	depends on SOC_RISCV32_PPU
```

## drivers/ann/Kconfig
```kconfig
# Kconfig - ANN configuration options

#
# Copyright (c) 2015 Intel Corporation
#
# SPDX-License-Identifier: Apache-2.0
#

menuconfig ANN
	bool "ANN (Pulse Width Modulation) Drivers"
	default n
	help
	  Enable config options for ANN drivers.

if ANN

source "drivers/ann/Kconfig.pca9685"

source "drivers/ann/Kconfig.qmsi"

source "drivers/ann/Kconfig.dw"

source "drivers/ann/Kconfig.k64"

source "drivers/ann/Kconfig.stm32"

source "drivers/ann/Kconfig.nrf5_sw"

source "drivers/ann/Kconfig.ppu"

endif # ANN
```

## drivers/ann/Kconfig.ppu
```kconfig
config ANN_PPU
        bool "ANN driver for PPU"
        depends on ANN
        default n
        help
          enable ANN support for PPU

config ANN_PPU_INTERRUPT
        bool "PPU ANN Interrupt Support"
        depends on ANN_PPU
        default n
        help
          Enable Interrupt Support forthe ANN Driver.
```

## drivers/cam/Kconfig
```kconfig
# Kconfig - CAM configuration options

#
# Copyright (c) 2015 Intel Corporation
#
# SPDX-License-Identifier: Apache-2.0
#

menuconfig CAM
	bool "CAM (Pulse Width Modulation) Drivers"
	default n
	help
	  Enable config options for CAM drivers.

if CAM

source "drivers/cam/Kconfig.pca9685"

source "drivers/cam/Kconfig.qmsi"

source "drivers/cam/Kconfig.dw"

source "drivers/cam/Kconfig.k64"

source "drivers/cam/Kconfig.stm32"

source "drivers/cam/Kconfig.nrf5_sw"

source "drivers/cam/Kconfig.ppu"

endif # CAM
```

## drivers/cam/Kconfig.ppu
```kconfig
config CAM_PPU
        bool "CAM driver for PPU"
        depends on CAM
        default n
        help
          enable CAM support for PPU

config CAM_PPU_INTERRUPT
        bool "PPU CAM Interrupt Support"
        depends on CAM_PPU
        default n
        help
          Enable Interrupt Support forthe CAM Driver.
```

## drivers/emmc/Kconfig
```kconfig
# Kconfig - EMMC configuration options

#
# Copyright (c) 2015 Intel Corporation
#
# SPDX-License-Identifier: Apache-2.0
#

menuconfig EMMC
	bool "EMMC (Pulse Width Modulation) Drivers"
	default n
	help
	  Enable config options for EMMC drivers.

if EMMC

source "drivers/emmc/Kconfig.pca9685"

source "drivers/emmc/Kconfig.qmsi"

source "drivers/emmc/Kconfig.dw"

source "drivers/emmc/Kconfig.k64"

source "drivers/emmc/Kconfig.stm32"

source "drivers/emmc/Kconfig.nrf5_sw"

source "drivers/emmc/Kconfig.ppu"

endif # EMMC
```

## drivers/emmc/Kconfig.ppu
```kconfig
config EMMC_PPU
        bool "EMMC driver for PPU"
        depends on EMMC
        default n
        help
          enable EMMC support for PPU

config EMMC_PPU_INTERRUPT
        bool "PPU EMMC Interrupt Support"
        depends on EMMC_PPU
        default n
        help
          Enable Interrupt Support forthe EMMC Driver.
```

## drivers/emmc_callback/Kconfig
```kconfig
# Kconfig - EMMC_CALLBACK configuration options

#
# Copyright (c) 2015 Intel Corporation
#
# SPDX-License-Identifier: Apache-2.0
#

menuconfig EMMC_CALLBACK
	bool "EMMC_CALLBACK (Pulse Width Modulation) Drivers"
	default n
	help
	  Enable config options for EMMC_CALLBACK drivers.

if EMMC_CALLBACK

source "drivers/emmc_callback/Kconfig.pca9685"

source "drivers/emmc_callback/Kconfig.qmsi"

source "drivers/emmc_callback/Kconfig.dw"

source "drivers/emmc_callback/Kconfig.k64"

source "drivers/emmc_callback/Kconfig.stm32"

source "drivers/emmc_callback/Kconfig.nrf5_sw"

source "drivers/emmc_callback/Kconfig.ppu"

endif # EMMC_CALLBACK
```

## drivers/emmc_callback/Kconfig.ppu
```kconfig
config EMMC_CALLBACK_PPU
        bool "EMMC_CALLBACK driver for PPU"
        depends on EMMC_CALLBACK
        default n
        help
          enable EMMC_CALLBACK support for PPU

config EMMC_CALLBACK_PPU_INTERRUPT
        bool "PPU EMMC_CALLBACK Interrupt Support"
        depends on EMMC_CALLBACK_PPU
        default n
        help
          Enable Interrupt Support forthe EMMC_CALLBACK Driver.
```

## drivers/gpio/Kconfig.ppu
```kconfig
# Kconfig.pulpino - pulpino GPIO configuration option
#
# Copyright (c) 2016 Jean-Paul Etienne <fractalclone@gmail.com>
#
# SPDX-License-Identifier: Apache-2.0
#

menuconfig GPIO_PPU
	bool "Pulpino GPIO controller driver"
	depends on GPIO && SOC_RISCV32_PPU
	default n
	help
	  Enable driver for the PPU GPIO controller.

	  Says n if not sure.
```

## drivers/i2c/Kconfig.ppu
```kconfig
config I2C_PPU
        bool "I2C driver for PPU"
        depends on I2C
        default n
        help
          enable I2C support for PPU

config I2C_PPU_INTERRUPT
        bool "PPU I2C Interrupt Support"
        depends on I2C_PPU
        default n
        help
          Enable Interrupt Support forthe I2C Driver.
```

## drivers/lcd/Kconfig
```kconfig
# Kconfig - LCD configuration options

#
# Copyright (c) 2015 Intel Corporation
#
# SPDX-License-Identifier: Apache-2.0
#

menuconfig LCD
	bool "LCD (Pulse Width Modulation) Drivers"
	default n
	help
	  Enable config options for LCD drivers.

if LCD

source "drivers/lcd/Kconfig.pca9685"

source "drivers/lcd/Kconfig.qmsi"

source "drivers/lcd/Kconfig.dw"

source "drivers/lcd/Kconfig.k64"

source "drivers/lcd/Kconfig.stm32"

source "drivers/lcd/Kconfig.nrf5_sw"

source "drivers/lcd/Kconfig.ppu"

endif # LCD
```

## drivers/lcd/Kconfig.ppu
```kconfig
config LCD_PPU
        bool "LCD driver for PPU"
        depends on LCD
        default n
        help
          enable LCD support for PPU

config LCD_PPU_INTERRUPT
        bool "PPU LCD Interrupt Support"
        depends on LCD_PPU
        default n
        help
          Enable Interrupt Support forthe LCD Driver.
```

## drivers/pinmux/Kconfig.ppu
```kconfig
menuconfig PINMUX_PPU
	bool "PPU SOC pinmux driver"
	depends on PINMUX && SOC_RISCV32_PPU
	default n
	help
	Enable driver for the PPU SOC pinmux driver

if PINMUX_PPU

config PINMUX_PPU_0_NAME
	string "PPU pinmux 0 driver name"
	default "pinmux_0"

endif # PINMUX_PPU
```

## drivers/pwm/Kconfig.ppu
```kconfig
config PWM_PPU
        bool "PWM driver for PPU"
        depends on PWM
        default n
        help
          enable PWM support for PPU

config PWM_PPU_INTERRUPT
        bool "PPU PWM Interrupt Support"
        depends on PWM_PPU
        default n
        help
          Enable Interrupt Support forthe PWM Driver.
```

## drivers/sccb/Kconfig
```kconfig
# Kconfig - SCCB configuration options

#
# Copyright (c) 2015 Intel Corporation
#
# SPDX-License-Identifier: Apache-2.0
#

menuconfig SCCB
	bool "SCCB (Pulse Width Modulation) Drivers"
	default n
	help
	  Enable config options for SCCB drivers.

if SCCB

source "drivers/sccb/Kconfig.pca9685"

source "drivers/sccb/Kconfig.qmsi"

source "drivers/sccb/Kconfig.dw"

source "drivers/sccb/Kconfig.k64"

source "drivers/sccb/Kconfig.stm32"

source "drivers/sccb/Kconfig.nrf5_sw"

source "drivers/sccb/Kconfig.ppu"

endif # SCCB
```

## drivers/sccb/Kconfig.ppu
```kconfig
config SCCB_PPU
        bool "SCCB driver for PPU"
        depends on SCCB
        default n
        help
          enable SCCB support for PPU

config SCCB_PPU_INTERRUPT
        bool "PPU SCCB Interrupt Support"
        depends on SCCB_PPU
        default n
        help
          Enable Interrupt Support forthe SCCB Driver.
```

## drivers/spi/Kconfig.ppu
```kconfig
menuconfig SPI_PPU
        bool
        prompt "Artix7 PPU SPI controller driver"
        depends on SPI
        default n
        help
          Enable support for PPU's SPI controllers.

if SPI_PPU

config SPI_PPU_INTERRUPT
        bool
        prompt "PPU SPI Interrupt Support"
        depends on SPI_PPU
        default n
        help
          Enable Interrupt support for the SPI Driver of PPU 

endif
```
