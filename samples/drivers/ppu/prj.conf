## prj.conf
```kconfig
CONFIG_PINMUX=y
CONFIG_PINMUX_PPU=y
CONFIG_SPI_LEGACY_API=n
CONFIG_SPI=y
CONFIG_SPI_1=y
CONFIG_SPI_1_IRQ_PRI=1
CONFIG_SPI_PPU=y
CONFIG_SPI_CAM=y
CONFIG_I2C=y
CONFIG_I2C_PPU=y
CONFIG_PWM=y
CONFIG_PWM_PPU=y
CONFIG_LCD=y
CONFIG_LCD_PPU=y
CONFIG_SCCB=y
CONFIG_SCCB_PPU=y
CONFIG_CAM=y
CONFIG_CAM_PPU=y
CONFIG_CAM_IRQ_PRI=0
CONFIG_ANN=y
CONFIG_ANN_PPU=y
CONFIG_ANN_IRQ_PRI=1
CONFIG_EMMC=y
CONFIG_EMMC_PPU=y
CONFIG_EMMC_IRQ_PRI=1
CONFIG_EMMC_CALLBACK=y
CONFIG_EMMC_CALLBACK_PPU=y
```

## src/main.c
```c
/*
 * Copyright (c) 2015 Intel Corporation
 *
 * SPDX-License-Identifier: Apache-2.0
 */

/**
 * @file Sample app to utilize GPIO on Arduino 101 and Arduino Due.
 *
 * Sensortag CC2650 - ARM
 * --------------------
 *
 * LED1 is on DIO_10
 * LED2 is on DIO_15
 * BUTTON1 is on DIO_4
 * BUTTON2 is on DIO_0
 *
 * This sample toogles LED1 and wait interrupt on BUTTON1.
 * Note that an internet pull-up is set on BUTTON1 as the button
 * only drives low when pressed.
 *
 * Arduino 101 - x86
 * --------------------
 *
 * On x86 side of Arduino 101:
 * 1. GPIO_16 is on IO8
 * 2. GPIO_19 is on IO4
 *
 * The gpio_dw driver is being used.
 *
 * This sample app toggles GPIO_16/IO8. It also waits for
 * GPIO_19/IO4 to go high and display a message.
 *
 * If IO4 and IO8 are connected together, the GPIO should
 * triggers every 2 seconds. And you should see this repeatedly
 * on console:
 * "
 *     Toggling GPIO_16
 *     Toggling GPIO_16
 *     GPIO_19 triggered
 * "
 *
 * Arduino 101 - Sensor Subsystem
 * ------------------------------
 *
 * On Sensor Subsystem of Arduino 101:
 * 1. GPIO_SS[ 2] is on A00
 * 2. GPIO_SS[ 3] is on A01
 * 3. GPIO_SS[ 4] is on A02
 * 4. GPIO_SS[ 5] is on A03
 * 5. GPIO_SS[10] is on IO3
 * 6. GPIO_SS[11] is on IO5
 * 7. GPIO_SS[12] is on IO6
 * 8. GPIO_SS[13] is on IO9
 *
 * There are two 8-bit GPIO controllers on the sensor subsystem.
 * GPIO_SS[0-7] are on GPIO_0 while GPIO_SS[8-15] are on GPIO_1.
 *
 * The gpio_dw driver is being used. The first GPIO controller
 * is mapped to device "GPIO_0", and the second GPIO controller
 * is mapped to device "GPIO_1".
 *
 * This sample app toggles GPIO_SS_2/A0. It also waits for
 * GPIO_SS_3/A1 to go high and display a message.
 *
 * If A0 and A1 are connected together, the GPIO should
 * triggers every 2 seconds. And you should see this repeatedly
 * on console (via ipm_console0):
 * "
 *     Toggling GPIO_SS_2
 *     Toggling GPIO_SS_2
 *     GPIO_SS_3 triggered
 * "
 *
 * Arduino Due
 * -----------
 *
 * On Arduino Due:
 * 1. IO_2 is PB25
 * 2. IO_13 is PB27 (linked to the LED marked "L")
 *
 * The gpio_atmel_sam3 driver is being used.
 *
 * This sample app toggles IO_2. It also waits for
 * IO_13 to go high and display a message.
 *
 * If IO_2 and IO_13 are connected together, the GPIO should
 * triggers every 2 seconds. And you should see this repeatedly
 * on console:
 * "
 *     Toggling GPIO_25
 *     Toggling GPIO_25
 *     GPIO_27 triggered
 * "
 *
 * Quark D2000 CRB
 * ---------------
 *
 * In order to this sample app work with Quark D2000 CRB you should
 * use a "jumper cable" connecting the pins as described below:
 * Header J5 pin 9
 * Header J6 pin 7
 *
 * If the app runs successfully you should see this repeatedly on
 * console:
 * "
 * Toggling GPIO_8
 * Toggling GPIO_8
 * GPIO_24 triggered
 * "
 */

#include <zephyr.h>

#include <misc/printk.h>

#include <device.h>
#include <gpio.h>
#include <misc/util.h>

#if defined(CONFIG_SOC_QUARK_SE_C1000_SS)
#define GPIO_OUT_PIN	2
#define GPIO_INT_PIN	3
#define GPIO_NAME	"GPIO_SS_"
#elif defined(CONFIG_SOC_QUARK_SE_C1000)
#define GPIO_OUT_PIN	16
#define GPIO_INT_PIN	19
#define GPIO_NAME	"GPIO_"
#elif defined(CONFIG_SOC_PART_NUMBER_SAM3X8E)
#define GPIO_OUT_PIN	25
#define GPIO_INT_PIN	27
#define GPIO_NAME	"GPIO_"
#elif defined(CONFIG_SOC_QUARK_D2000)
#define GPIO_OUT_PIN	8
#define GPIO_INT_PIN	24
#define GPIO_NAME	"GPIO_"
#elif defined(CONFIG_SOC_CC2650)
#define GPIO_OUT_PIN	10
#define GPIO_INT_PIN	4
#define GPIO_NAME	"GPIO_"
#endif

#if defined(CONFIG_GPIO_DW_0)
#define GPIO_DRV_NAME CONFIG_GPIO_DW_0_NAME
#elif defined(CONFIG_GPIO_QMSI_0) && defined(CONFIG_SOC_QUARK_SE_C1000)
#define GPIO_DRV_NAME CONFIG_GPIO_QMSI_0_NAME
#elif defined(CONFIG_GPIO_QMSI_SS_0)
#define GPIO_DRV_NAME CONFIG_GPIO_QMSI_SS_0_NAME
#elif defined(CONFIG_GPIO_ATMEL_SAM3)
#define GPIO_DRV_NAME CONFIG_GPIO_ATMEL_SAM3_PORTB_DEV_NAME
#else
#define GPIO_DRV_NAME "GPIO_0"
#endif

void gpio_callback(struct device *port,
		   struct gpio_callback *cb, u32_t pins)
{
	printk("GPIO_NAME %d triggered\n", GPIO_INT_PIN);
}

static struct gpio_callback gpio_cb;

void main(void)
{
	struct device *gpio_dev;
	int ret;
	int toggle = 1;

	gpio_dev = device_get_binding(GPIO_DRV_NAME);
	if (!gpio_dev) {
		printk("Cannot find %s!\n", GPIO_DRV_NAME);
		return;
	}

	/* Setup GPIO output */
	ret = gpio_pin_configure(gpio_dev, GPIO_OUT_PIN, (GPIO_DIR_OUT));
	if (ret) {
		printk("Error configuring GPIO_NAME %d!\n", GPIO_OUT_PIN);
	}

	/* Setup GPIO input, and triggers on rising edge. */
#ifdef CONFIG_SOC_CC2650
	ret = gpio_pin_configure(gpio_dev, GPIO_INT_PIN,
				 (GPIO_DIR_IN | GPIO_INT |
				  GPIO_INT_EDGE | GPIO_INT_ACTIVE_HIGH |
				  GPIO_INT_DEBOUNCE | GPIO_PUD_PULL_UP));
#else
	ret = gpio_pin_configure(gpio_dev, GPIO_INT_PIN,
				 (GPIO_DIR_IN | GPIO_INT |
				  GPIO_INT_EDGE | GPIO_INT_ACTIVE_HIGH |
				  GPIO_INT_DEBOUNCE));
#endif
	if (ret) {
		printk("Error configuring GPIO_NAME %d!\n", GPIO_INT_PIN);
	}

	gpio_init_callback(&gpio_cb, gpio_callback, BIT(GPIO_INT_PIN));

	ret = gpio_add_callback(gpio_dev, &gpio_cb);
	if (ret) {
		printk("Cannot setup callback!\n");
	}

	ret = gpio_pin_enable_callback(gpio_dev, GPIO_INT_PIN);
	if (ret) {
		printk("Error enabling callback!\n");
	}

	while (1) {
		printk("Toggling  GPIO_NAME %d\n", GPIO_OUT_PIN);

		ret = gpio_pin_write(gpio_dev, GPIO_OUT_PIN, toggle);
		if (ret) {
			printk("Error set GPIO_NAME %d!\n", GPIO_OUT_PIN);
		}

		if (toggle) {
			toggle = 0;
		} else {
			toggle = 1;
		}

		k_sleep(MSEC_PER_SEC);
	}
}
```

## src/ann.c
```c
#include <misc/printk.h>
#include <device.h>
#include <cam.h>
#include <gpio.h>
#include <spi.h>
#include <misc/util.h>
#include "testANN.h"
#include <ann.h>
#include <stdio.h>
#include <stdlib.h>

#define ANN_DRV_NAME "ann_0"
#define LCD_DRV_NAME "lcd_0"

#define LCD_W 320
#define LCD_H 480
#define WHITE            0xFCFCFC
#define BLACK            0x000000     
#define BLUE             0xFC0000  
#define RED              0x0000FC
#define GREEN            0x00FC00
#define BRED             0XF81F
#define GRED             0XFFE0
#define GBLUE            0X07FF
#define MAGENTA          0xF81F
#define CYAN             0x7FFF
#define YELLOW           0xFFE0
#define BROWN            0XBC40 //棕色
#define BRRED            0XFC07 //棕红色
#define GRAY             0X8430 //灰色

#define FRAME1_ADDR       0x32020000
#define FRAME2_ADDR       0x33040000
#define FRAME3_ADDR       0x34060000

volatile int count = 0;
int* Dst_Addr;
volatile int Isr_Type;
unsigned char image_sampled[28*28];
unsigned char image_normal[28*28];

u8_t cmd = 0x9F;
u8_t cmd1 = 0x06;
u8_t cmd2 = 0x71;
u32_t addr = 0x80000410;
u32_t data = 0;

// macro constants
#define   SET_FM1_INT   1
#define UNSET_FM1_INT   0

#define   SET_FM2_INT   1
#define UNSET_FM2_INT   0

#define   SET_FM3_INT   1
#define UNSET_FM3_INT   0

#define   SET_RQFUL_INT   1
#define UNSET_RQFUL_INT   0

#define   SET_RQOVF_INT   1
#define UNSET_RQOVF_INT   0

#define   SET_PROERR_INT   1
#define UNSET_PROERR_INT   0

//u32_t dis_line = 15;
volatile int Isr_Type;
u32_t BACK_COLOR, POINT_COLOR;
struct device *lcd_dev;

void check_result(char* Dst_Addr)
{
    lcd_dev = device_get_binding(LCD_DRV_NAME);
    int test_i;
    signed char res=0;
    signed char big_last=0;
    signed char big_num=0;
    
    for(test_i=0;test_i<10;test_i++)
    {
      res = *(Dst_Addr + test_i);
      printk("%02x ",res);
      if(res > big_last){
        big_num = test_i;
        big_last = res;
      }
    }
    printk("big_num:%x\n",big_num);
    if(big_num==0)
     printf_lcd("NUMBER: 0", lcd_dev);
    else if(big_num==1)
     printf_lcd("NUMBER: 1", lcd_dev);
   else if(big_num==2)
     printf_lcd("NUMBER: 2", lcd_dev);
   else if(big_num==3)
     printf_lcd("NUMBER: 3", lcd_dev);
   else if(big_num==4)
     printf_lcd("NUMBER: 4", lcd_dev);
   else if(big_num==5)
     printf_lcd("NUMBER: 5", lcd_dev);
   else if(big_num==6)
     printf_lcd("NUMBER: 6", lcd_dev);
   else if(big_num==7)
     printf_lcd("NUMBER: 7", lcd_dev);
   else if(big_num==8)
     printf_lcd("NUMBER: 8", lcd_dev);
   else if(big_num==9)
     printf_lcd("NUMBER: 9", lcd_dev);
}

void main(void)
{
    printk("This is Zephyr ANN_PPU Driver Test...\n");
    printk("Find device...\n");

    struct device *ann_dev;

    ann_dev = device_get_binding(ANN_DRV_NAME);
    if(!ann_dev)
    {
        printk("Cannot find %s!\n", ANN_DRV_NAME);
        //return;
    }
    
    printk("Find %s!\n", ANN_DRV_NAME);

    struct device *gpio_dev;
    gpio_dev = device_get_binding("gpio0");
    if(!gpio_dev)
    {
        printk("Cannot find %s!\n", "gpio0");
        return;
    }
    printk("Find gpio0!\n");

    lcd_dev = device_get_binding(LCD_DRV_NAME);
    if(!lcd_dev)
    {
        printk("Cannot find %s!\n", LCD_DRV_NAME);
        //return;
    }
    
    printk("Find %s!\n", LCD_DRV_NAME);

    int ret;
    ret = lcd_config(lcd_dev, gpio_dev);
    if(ret) {
        printk("LCD config error\n");
        //return;
    }
    printk("LCD config success\n");

    BACK_COLOR=BLACK;
    POINT_COLOR=WHITE;
    LCD_DrawRectangle(lcd_dev,49, 49, 106, 106);

    printk("Zephyr LCD_PPU Driver Test Successed.....\n");

    //Dst_Addr = (int*)malloc(sizeof(int) * NPU_DATAOUT_DEPTH0);
    Dst_Addr = (int*)0x50010000;
    printk("this is %x\n", Dst_Addr);
    struct device *sccb_dev = device_get_binding("sccb");
    if(!sccb_dev) {
        printk("Cannot find sccb\n");
    }
    printk("find sccb0!!\n");

    SCCB_init(sccb_dev);
    SCCB_WriteByte(sccb_dev, 0x12, 0x80);
    SCCB_WriteByte(sccb_dev, 0x11, 0x01);
    SCCB_WriteByte(sccb_dev, 0x0d, 0x00);
    SCCB_WriteByte(sccb_dev, 0x12, 0x40);

    SCCB_ReadByte(sccb_dev, 0x12);
    SCCB_ReadByte(sccb_dev, 0x0d);
    printk("Zephyr SCCB Driver Test Successed.....\n");

    struct device *cam_dev = device_get_binding("cam_0");
    if(!cam_dev) {
        printk("Cannot find cam_0\n");
    }
    printk("find cam_0!!\n");
    Isr_Type = 0;
    camctl_init(cam_dev);
    printk("Camera init done!!!\n");

    //int_enable();
    PPU_IER |= (1<< 16); //enable ann interrupt
    init_pro(ann_dev, IM_DEPTH0, WEIGTH_DEPTH0, BIAS_DEPTH0, (int)&Ann_Config, DMA_BLOCK_INFO0);
    printk("ANN init done!!!\n");

    camctl_start(cam_dev);
    while(1){
       if(Isr_Type != 0)
        {
           if(Isr_Type == 1) {
                sample_image(ann_dev, (volatile unsigned char*)FRAME1_ADDR, image_sampled);
                normalization_image(ann_dev, image_sampled);
                qfix_image(ann_dev, image_sampled, (char*)&data_input);
                npu_pro(ann_dev, NPU_DATAIN_DEPTH0, NPU_DATAOUT_DEPTH0, (int)&data_input,  (int)Dst_Addr, NPU_DMA_BLOCK_INFO0 ); 
                while(count!=2) {
                  }
                count=0;
                check_result((char*)Dst_Addr);
            }
            else if(Isr_Type == 2){
                sample_image(ann_dev, (volatile unsigned char*)FRAME2_ADDR,image_sampled);
                normalization_image(ann_dev, image_sampled);
                qfix_image(ann_dev, image_sampled, (char*)&data_input);
                npu_pro(ann_dev, NPU_DATAIN_DEPTH0, NPU_DATAOUT_DEPTH0, (int)&data_input,  (int)Dst_Addr, NPU_DMA_BLOCK_INFO0 ); 
                while(count!=2) {
                 }
                count=0;
                check_result((char*)Dst_Addr);
            }
            else if(Isr_Type == 3){
                sample_image(ann_dev, (volatile unsigned char*)FRAME3_ADDR,image_sampled);
                normalization_image(ann_dev, image_sampled);
                qfix_image(ann_dev, image_sampled, (char*)&data_input);
                npu_pro(ann_dev, NPU_DATAIN_DEPTH0, NPU_DATAOUT_DEPTH0, (int)&data_input,  (int)Dst_Addr, NPU_DMA_BLOCK_INFO0 ); 
                while(count!=2) {
                  }
                count=0;
                check_result((char*)Dst_Addr);
            }
        Isr_Type = 0;
        camctl_int_enable(SET_FM1_INT, SET_FM2_INT, SET_FM3_INT, UNSET_RQFUL_INT, UNSET_RQOVF_INT, SET_PROERR_INT);
        camctl_start(cam_dev); //open the camera
        }
    }
  return 0;
}
```

## src/cam.c
```c
#include <misc/printk.h>
#include <device.h>
#include <cam.h>
#include <gpio.h>
#include <spi.h>
#include <misc/util.h>
#include "oledfont.h"
#include "bmp.h"
//#include <int.h>

#define LCD_DRV_NAME "lcd_0"

#define LCD_W 320
#define LCD_H 480
#define WHITE            0xFCFCFC
#define BLACK            0x000000     
#define BLUE             0xFC0000  
#define RED              0x0000FC
#define GREEN            0x00FC00
#define BRED             0XF81F
#define GRED             0XFFE0
#define GBLUE            0X07FF
#define MAGENTA          0xF81F
#define CYAN             0x7FFF
#define YELLOW           0xFFE0
#define BROWN            0XBC40 //棕色
#define BRRED            0XFC07 //棕红色
#define GRAY             0X8430 //灰色

#define FRAME1_ADDR       0x32020000
#define FRAME2_ADDR       0x33040000
#define FRAME3_ADDR       0x34060000

u8_t cmd = 0x9F;
u8_t cmd1 = 0x06;
u8_t cmd2 = 0x71;
u32_t addr = 0x80000410;
u32_t data = 0;

// macro constants
#define   SET_FM1_INT   1
#define UNSET_FM1_INT   0

#define   SET_FM2_INT   1
#define UNSET_FM2_INT   0

#define   SET_FM3_INT   1
#define UNSET_FM3_INT   0

#define   SET_RQFUL_INT   1
#define UNSET_RQFUL_INT   0

#define   SET_RQOVF_INT   1
#define UNSET_RQOVF_INT   0

#define   SET_PROERR_INT   1
#define UNSET_PROERR_INT   0

//u32_t dis_line = 15;
volatile int Isr_Type;
u32_t BACK_COLOR, POINT_COLOR;

void waste_time(volatile int delay);

struct spi_config spi0 = {
    .frequency = 5000000,
    .operation = SPI_OP_MODE_MASTER | SPI_LINES_SINGLE,
    .slave = 0,
    .cs = NULL,
};


void main(void)
{
    printk("This is Zephyr CAM_PPU Driver Test...\n");
    printk("Find device...\n");

    struct device *lcd_dev;

    lcd_dev = device_get_binding(LCD_DRV_NAME);
    if(!lcd_dev)
    {
        printk("Cannot find %s!\n", LCD_DRV_NAME);
        //return;
    }
    
    printk("Find %s!\n", LCD_DRV_NAME);

    struct device *gpio_dev;
    gpio_dev = device_get_binding("gpio0");
    if(!gpio_dev)
    {
        printk("Cannot find %s!\n", "gpio0");
        return;
    }
    printk("Find gpio0!\n");

    int ret;
    ret = lcd_config(lcd_dev, gpio_dev);
    if(ret) {
        printk("LCD config error\n");
        //return;
    }
    printk("LCD config success\n");

    BACK_COLOR=BLACK;
    POINT_COLOR=WHITE;
    display_shade(lcd_dev, 110);
    display_image(lcd_dev, 5, 100, 105 - 1, 200 - 1, (volatile unsigned char*)logo);
    printf_lcd("ICT WuSystem!", lcd_dev);
    POINT_COLOR = GREEN;
    printf_lcd("      U", lcd_dev);                                                      
    printf_lcd("  UUUUUUUU       UUUUUUUU    UUU    UUU", lcd_dev);
    printf_lcd(" U    U   U       U      U    U      U", lcd_dev);
    printf_lcd("U     U    U      U      U    U      U", lcd_dev);
    printf_lcd("U     U    U      U     U     U      U", lcd_dev);
    printf_lcd(" UU   U   UU      U Chip      U      U", lcd_dev);
    printf_lcd("   UUUUUUU        U     5G    U      U", lcd_dev);
    printf_lcd("      U   RISC-V  U      AI   U      U", lcd_dev);
    printf_lcd("      UU         UUUUUUU  IOT  UUUUUU", lcd_dev);
    POINT_COLOR=WHITE;
    printk("Zephyr LCD_PPU Driver Test Successed.....\n");

    struct device *sccb_dev = device_get_binding("sccb");
    if(!sccb_dev) {
        printk("Cannot find sccb\n");
    }
    printk("find sccb0!!\n");

    SCCB_init(sccb_dev);
    SCCB_WriteByte(sccb_dev, 0x12, 0x80);
    SCCB_WriteByte(sccb_dev, 0x11, 0x01);
    SCCB_WriteByte(sccb_dev, 0x0d, 0x00);
    SCCB_WriteByte(sccb_dev, 0x12, 0x06);

    SCCB_ReadByte(sccb_dev, 0x18);
    SCCB_ReadByte(sccb_dev, 0x1A);
    printk("Zephyr SCCB Driver Test Successed.....\n");

    struct device *cam_dev = device_get_binding("cam_0");
    if(!cam_dev) {
        printk("Cannot find cam_0\n");
    }
    printk("find cam_0!!\n");
    Isr_Type = 0;
    camctl_init(cam_dev);
    printk("Camera init done!!!\n");

    //int_enable();
    PPU_IER |= (1<< 17); //enable camera interrupt
    PPU_EER |= (1<< 17); //enable camera interrupt
    printk("INT_CAM init done!!!\n");

    camctl_start(cam_dev);
    while(1){
     if(Isr_Type != 0)
    {
       printk("Get in ISR, Service Type: %d\n", Isr_Type);
           if(Isr_Type == 1) {
                display_cam(lcd_dev, (volatile unsigned char*)FRAME1_ADDR);
        }
       else if(Isr_Type == 2){
               display_cam(lcd_dev, (volatile unsigned char*)FRAME2_ADDR);
        }
       else if(Isr_Type == 3){
               display_cam(lcd_dev, (volatile unsigned char*)FRAME3_ADDR);
        }
          Isr_Type = 0;
          camctl_int_enable(cam_dev, SET_FM1_INT, SET_FM2_INT, SET_FM3_INT, UNSET_RQFUL_INT, UNSET_RQOVF_INT, SET_PROERR_INT);
          camctl_start(cam_dev);   //open the camera
    }
}
  return 0;
}

void waste_time(volatile int delay)
{
    volatile int i;
    delay = delay * 400;
    for(i = 0; i < delay; i++);
}
```

## src/i2c.c
```c
#include <zephyr.h>
#include <misc/printk.h>
#include <device.h>
#include <pinmux.h>
#include <i2c.h>
#include <misc/util.h>
#include <emmc.h>

#define I2C_FUNC 0

static union dev_config i2c_cfg = {
	.raw = 0,
	.bits = {
		.use_10_bit_addr = 0,
		.is_master_device = 0,
		.speed = I2C_SPEED_STANDARD,
	},
};

void main()
{
    printk("This is Zephyr I2C_PPU Driver test... \n");
    struct device *i2c_dev = device_get_binding("i2c0");
    if(!i2c_dev) {
        printk("Cannot find i2c0\n");
    }
    printk("find i2c0!!\n");

    int ret;
    ret = i2c_configure(i2c_dev, i2c_cfg.raw);
    if (ret) {
	printk("I2C config failed\n");
	return;
    }
    printk("configure over\n");
    printk("this11 is %x\n", EMMC_REG_CTRL);
    printk("this12 is %x\n", L_EMMC_REG_CTRL);

//    i2c_transfer(i2c_dev, NULL, 0, 0x00);
//    printk("i2c transceive over\n");
 
//    unsigned char datas[20] = {0};
//    unsigned char rdatas[20] = {0};
   
//    for(int i = 0; i < 10; i++)
//        datas[i] = i;

//    i2c_write(i2c_dev, datas, 16, 0xA0);
//    printk("data send over\n");

//    i2c_read(i2c_dev, rdatas, 16, 0xA1);
//    printk("read data over\n");

    
    unsigned char datas[40] = {0};
    unsigned char rdatas[40] = {0};
    unsigned char rrdatas[40] = {0};

    datas[0] = 0x00;
//    datas[1] = 0x00;

    for(int i = 0; i < 12; i++)
        datas[i+1] = 2*(i + 1);

   
    i2c_write(i2c_dev, datas, 13, 0xA0);
    printk("data send over\n");

    i2c_write(i2c_dev, NULL, 0, 0xA0);
    printk("acknowledge poll over\n");

    i2c_write(i2c_dev, datas, 1, 0xA0);
    printk("read data addr send over\n");
    
    i2c_read(i2c_dev, rdatas, 12, 0xA1);
    printk("read data over\n");

    for(int i = 0; i < 12; i++)
    {
        printk("data %d is: %d\n", 2*(i+1), rdatas[i]);
    }


    for(int i = 0; i < 16; i++)
        datas[i+1] = 3*(i + 1);

    i2c_write(i2c_dev, datas, 17, 0xA0);
    printk("2data send over\n");

    i2c_write(i2c_dev, NULL, 0, 0xA0);
    printk("acknowledge poll over\n");

    i2c_write(i2c_dev, datas, 1, 0xA0);
    printk("2read data addr send over\n");
    
    i2c_read(i2c_dev, rrdatas, 17, 0xA1);
    printk("2read data over\n");

    for(int i = 0; i < 16; i++)
    {
        printk("2data %d is: %d\n", 3*(i+1), rrdatas[i]);
    }

}
```

## src/pinmux_gpio.c
```c
#include <zephyr.h>
#include <misc/printk.h>
#include <device.h>
#include <pinmux.h>
#include <gpio.h>
#include <misc/util.h>

#define PINMUX_DRV_NAME "pinmux_0"
#define GPIO_FUNC 1
#define GPIO_OUT_PIN 1
#define GPIO_INT_PIN 2
void waste_time(void);
void gpio_callback(struct device *port,
		   struct gpio_callback *cb, u32_t pins)
{
	printk("gpio0 triggered\n");
}

static struct gpio_callback gpio_cb;

void main(void)
{
    printk("Find device...\n");

    struct device *pinmux_dev;

    pinmux_dev = device_get_binding(PINMUX_DRV_NAME);
    if(!pinmux_dev)
    {
        printk("Cannot find %s!\n", PINMUX_DRV_NAME);
        return;
    }
    
    printk("Find %s!\n", PINMUX_DRV_NAME);

    pinmux_pin_set(pinmux_dev, GPIO_OUT_PIN, GPIO_FUNC);
    pinmux_pin_set(pinmux_dev, 3, GPIO_FUNC);
    printk("success\n");
    u32_t func0 = 0;
    u32_t func1 = 0;
    
    pinmux_pin_get(pinmux_dev, GPIO_OUT_PIN, &func0);
    pinmux_pin_get(pinmux_dev, 3, &func1);

    if(func0 && func1)
        printk("pin function set success\n");
    else
        printk("pin function set failed\n");   

    
    struct device *gpio_dev;
    gpio_dev = device_get_binding("gpio0");
    if(!gpio_dev)
    {
        printk("Cannot find %s!\n", "gpio0");
        return;
    }

    printk("Find gpio0!\n");

    int ret = gpio_pin_configure(gpio_dev, GPIO_OUT_PIN, GPIO_DIR_OUT);
    if(ret)
    {
        printk("Error configuring gpio pin0\n");
        return;
    }
   
    //ret = gpio_pin_configure(gpio_dev, GPIO_INT_PIN, (GPIO_DIR_IN | GPIO_INT |
    //                                                  GPIO_INT_EDGE | GPIO_INT_ACTIVE_HIGH));
    //if(ret)
    //{
    //    printk("Error configuring gpio pin1\n");
    //    return;
    //}

    //gpio_init_callback(&gpio_cb, gpio_callback, BIT(GPIO_INT_PIN));

    //ret = gpio_add_callback(gpio_dev, &gpio_cb);
    //if (ret) {
 	//printk("Cannot setup callback!\n");
    //}

    //ret = gpio_pin_enable_callback(gpio_dev, GPIO_INT_PIN);
    //if (ret) {
	//printk("Error enabling callback!\n");
    //}
 
    int toggle =1;
    while(1)
    {
        ret = gpio_pin_write(gpio_dev, GPIO_OUT_PIN, toggle);
        if(ret)
        {
            printk("Error setting gpio\n");
            return;
        }
        if(toggle) toggle = 0;
        else       toggle = 1;
        //k_sleep(MSEC_PER_SEC);
        waste_time();
    }
}

void waste_time(void) {
     volatile int i;
     for(i = 0; i < 300000; i++);
  //  for(i = 0; i < 300; i++) asm volatile("nop");
 }
```

## src/pwm.c
```c
#include <misc/printk.h>
#include <device.h>
#include <pwm.h>
#include <misc/util.h>

#define PWM_DRV_NAME "pwm_0"
//#define GPIO_FUNC 1
//#define GPIO_OUT_PIN 1
//#define GPIO_INT_PIN 2
void waste_time(void);

void main(void)
{
    printk("This is Zephyr PWM_PPU Driver Test...\n");
    printk("Find device...\n");

    struct device *pwm_dev;

    pwm_dev = device_get_binding(PWM_DRV_NAME);
    if(!pwm_dev)
    {
        printk("Cannot find %s!\n", PWM_DRV_NAME);
        //return;
    }
    
    printk("Find %s!\n", PWM_DRV_NAME);

    int ret;
    ret = pwm_pin_set_cycles(pwm_dev, PWM_DRV_NAME, 1000000, 25000);
    if(ret) {
        printk("SPI transceive error\n");
        return;
    }
    printk("SPI transceive success\n");

    while (1){
    pwm_pin_set_cycles(pwm_dev, PWM_DRV_NAME, 1000000, 25000);
    waste_time();
    pwm_pin_set_cycles(pwm_dev, PWM_DRV_NAME, 1000000, 50000);
    waste_time();
    pwm_pin_set_cycles(pwm_dev, PWM_DRV_NAME, 1000000, 75000);
    waste_time();
    pwm_pin_set_cycles(pwm_dev, PWM_DRV_NAME, 1000000, 100000);
    waste_time();
    pwm_pin_set_cycles(pwm_dev, PWM_DRV_NAME, 1000000, 125000);
    waste_time();
}
   return 0;
}

void waste_time(void) {
     volatile int i;
     for(i = 0; i < 300000; i++);
  //  for(i = 0; i < 300; i++) asm volatile("nop");
 }
```

## src/spi.c
```c
#include <zephyr.h>
#include <misc/printk.h>
#include <device.h>
#include <pinmux.h>
#include <spi.h>
#include <misc/util.h>

#define SPI_NAME "SPI_0"
#define SPI_FUNC 0

#define BUF_SIZE 17

u8_t cmd = 0x9F;
u8_t cmd1 = 0x06;
u8_t cmd2 = 0x71;
u32_t addr = 0x80000410;
u32_t data = 0;

struct spi_config spi0 = {
    .frequency = 500000,
    .operation = SPI_OP_MODE_MASTER | SPI_LINES_SINGLE,
    .slave = 0,
    .cs = NULL,
};

int flash_get_cr1() {
    int status;
    u8_t rdcr1_cmd = 0x35;

    struct spi_buf tx[] = {
        {
            .buf = &rdcr1_cmd,
            .len = 1,
        },
    };
    struct spi_buf rx[] = {
        {
            .buf = &status,
            .len = 1,
        },
    };
    spi_transceive(&spi0, tx, 1, rx, 1);
    return status;
}

int flash_get_wip() {
    int status;
    u8_t rdcr1_cmd = 0x05;

    struct spi_buf tx[] = {
        {
            .buf = &rdcr1_cmd,
            .len = 1,
        },
    };
    struct spi_buf rx[] = {
        {
            .buf = &status,
            .len = 1,
        },
    };
    spi_transceive(&spi0, tx, 1, rx, 1);
    return status & 0x1;
}

void flash_sector_erase_parameter(u32_t addr) {
    while(flash_get_wip());
    u8_t wren_cmd = 0x06;
    u8_t p4e_cmd = 0x20;
    u32_t erase_addr = addr;
    struct spi_buf tx[] = {
        {
            .buf = &wren_cmd,
            .len = 1,
        },
        {
            .buf = &p4e_cmd,
            .len = 1,
        },
        {
            .buf = &erase_addr,
            .len = 3,
        },
    };

    spi_write(&spi0, tx, 1); 
    spi_write(&spi0, &tx[1], 2); 
}

void flash_write(u32_t addr, int* buffer, u32_t buf_len) {
    while(flash_get_wip());
    u8_t wren_cmd = 0x06;
    u8_t pp_cmd = 0x02;
    u32_t waddr = addr;
    
    struct spi_buf tx[] = {
        {
            .buf = &wren_cmd,
            .len = 1,
        },
        {
            .buf = &pp_cmd,
            .len = 1,
        },
        {
            .buf = &waddr,
            .len = 3,
        },
        {
            .buf = buffer,
            .len = buf_len,
        },
    };
    spi_write(&spi0, tx, 1); 
    spi_write(&spi0, &tx[1], 3);
}

void flash_read(u32_t addr, int* buffer, u32_t buf_len) {
    while(flash_get_wip());
    u8_t read_cmd = 0x13;
    u32_t raddr = addr;
    struct spi_buf tx[] = {
        {
            .buf = &read_cmd,
            .len = 1,
        },
        {
            .buf = &raddr,
            .len = 4,
        },
    };
    struct spi_buf rx[] = {
        {
            .buf = buffer,
            .len = buf_len,
        },
    };
    spi_transceive(&spi0, tx, 2, rx, 1);
}

void main()
{
    printk("This is Zephyr SPI_PPU Driver Test...\n");

    struct spi_buf tx_bufs[] = {
        {
            .buf = &cmd,
            .len = 1,
        },
        {
            .buf = &cmd1,
            .len = 1,
        },
        {
            .buf = &cmd2,
            .len = 1,
        },
        {
            .buf = &addr,
            .len = 4,
        },
    };
    struct spi_buf rx_bufs[] = {
        {
            .buf = &data,
            .len = 4,;
        },
    };

    spi0.dev = device_get_binding(SPI_NAME);
    if(!spi0.dev) {
        printk("Cannot find %s!\n", SPI_NAME);
        return;
    }
    else {
        printk("find spi0!\n");
    }

    int ret;
    ret = spi_transceive(&spi0, tx_bufs, 1, rx_bufs, 1);
    if(ret) {
        printk("SPI transceive error\n");
        return;
    }

    printk("flash id: %x\n", data);
    spi_write(&spi0, &tx_bufs[1], 1);
    int cr1 = flash_get_cr1();
    printk("The status is %d\n", cr1);
    if((cr1 & (1 << 2)) != 0) {
        printk("Read Flash Error!!!\n");
        return;
    }
    printk("CR1: %x\n", cr1);
    spi_write(&spi0, &tx_bufs[1], 1);
    spi_write(&spi0, &tx_bufs[2], 2);

    printk("Flash erasing...\n");
    flash_sector_erase_parameter(0x00);
    while(flash_get_wip());
    printk("Flash erased\n");
     
    int flash_data[10] = {0x1234, 0x2345, 0x3456, 0x4567, 0x5678, 0x6789, 0x7890, 0x8901, 0x9012, 0x0123};
    int rdata[10] = {0};

    flash_write(0x00, flash_data, 40);
    flash_read(0x00, rdata, 40);
 
    printk("SPI transceive over\n");
    printk("Flash read data back: %x\n", rdata[0]);
    printk("Flash read data back: %x\n", rdata[1]);
    printk("Flash read data back: %x\n", rdata[2]);
    printk("Flash read data back: %x\n", rdata[3]);
    printk("Flash read data back: %x\n", rdata[4]);
    printk("Flash read data back: %x\n", rdata[5]);
    printk("Flash read data back: %x\n", rdata[6]);
    printk("Flash read data back: %x\n", rdata[7]);
    printk("Flash read data back: %x\n", rdata[8]);
    printk("Flash read data back: %x\n", rdata[9]);
}
```
